## sdkconfig.defaults
```kconfig
# Target
CONFIG_IDF_TARGET="esp32c3"

# Flash
CONFIG_ESPTOOLPY_FLASHSIZE_4MB=y
CONFIG_ESPTOOLPY_FLASHFREQ_80M=y

# Crystal
CONFIG_XTAL_FREQ_40=y

# Compiler
CONFIG_COMPILER_OPTIMIZATION_SIZE=y
CONFIG_COMPILER_WARN_WRITE_STRINGS=y

# Watchdog
CONFIG_ESP_TASK_WDT_TIMEOUT_S=10
```
